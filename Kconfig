## Kconfig
```kconfig
config G0N_SCREEN_GLITCH
    bool "g0ndev: pantalla con logo glitch (Arasaka style)"
    select LV_USE_IMG
    select LV_USE_ANIMIMG

config G0N_SCREEN_BATT
    bool "g0ndev: pantalla con bateria de ambas mitades"
    select LV_USE_CANVAS
    select LV_USE_LABEL
    select LV_FONT_MONTSERRAT_12

config G0N_BATT_RELAY
    bool "g0ndev: el dongle reenvia la bateria de cada mitad a las mitades"
    depends on ZMK_SPLIT_RELAY_EVENT

config G0N_OLED_INVERTED
    bool "g0ndev: invertir colores"
```

## config/west.yml
```yaml
manifest:
  remotes:
    - name: gonzalonicolasr
      url-base: https://github.com/gonzalonicolasr
    - name: zmkfirmware
      url-base: https://github.com/zmkfirmware
    - name: gpeye
      url-base: https://github.com/GPeye
    - name: tokyo2006
      url-base: https://github.com/tokyo2006
    - name: englmaxi
      url-base: https://github.com/englmaxi
    - name: mctechnology17
      url-base: https://github.com/mctechnology17
    - name: cormoran
      url-base: https://github.com/cormoran
    - name: a741725193
      url-base: https://github.com/a741725193
    - name: zzeneg
      url-base: https://github.com/zzeneg
  projects:
    - name: mario-peripheral-animation
      remote: gpeye
      revision: main
    - name: zmk
      remote: cormoran
      revision: v0.3-branch+dya
      import: app/west.yml
    - name: zmk-behavior-runtime-sensor-rotate
      remote: cormoran
      revision: zmk-v0.3.0.0
    - name: zmk-module-ble-management
      remote: cormoran
      revision: zmk-v0.3.0.0
    - name: zmk-module-battery-history
      remote: cormoran
      revision: main
    - name: zmk-module-settings-rpc
      remote: cormoran
      revision: zmk-v0.3.0.0
    - name: zmk-module-runtime-input-processor
      remote: cormoran
      revision: zmk-v0.3.0.0
    - name: zmk-tog-io
      remote: a741725193
      revision: main
    - name: zmk-dongle-display
      remote: englmaxi
      revision: v0.3
    - name: zmk-nice-oled
      remote: mctechnology17
      revision: main
    - name: zmk-raw-hid
      remote: gonzalonicolasr
      revision: 9f87deda41f04578d2314a89bbd692bb2b618c21
  self:
    path: config
```

## g0n_hud/Kconfig
```kconfig
config G0N_HUD
    bool "g0ndev: HUD v2 en el dongle (la PC manda el framebuffer por raw HID)"
    depends on ZMK_DISPLAY && RAW_HID
    select LV_USE_IMG
    select THREAD_NAME

config G0N_HUD_NAME
    string "g0ndev: nombre de placa que devuelve la trama de version"
    depends on G0N_HUD
    default "corne" if SHIELD_EYESLASH_CORNE_CENTRAL_DONGLE
    default "sofle" if SHIELD_EYELASH_SOFLE_CENTRAL_DONGLE
    default "zmk"

config G0N_HUD_LED_FALLBACK
    bool "g0ndev: avisos de agente tambien por LED kana/compose"
    depends on G0N_HUD && ZMK_HID_INDICATORS
    default y

config G0N_HUD_SLIDE_MS
    int "g0ndev: duracion en ms del deslizamiento al entrar y salir del HUD (0 = corte seco)"
    depends on G0N_HUD
    default 0
```
